/ {
    chosen {
        zmk,kscan = &kscan0;
    };
};

&kscan0 {
    compatible = "zmk,kscan-gpio-matrix";

    diode-direction = "col2row";

    row-gpios =
        <&gpio0 9  (GPIO_ACTIVE_LOW | GPIO_PULL_UP)>,
        <&gpio0 10 (GPIO_ACTIVE_LOW | GPIO_PULL_UP)>,
        <&gpio0 111 (GPIO_ACTIVE_LOW | GPIO_PULL_UP)>,
        <&gpio0 113 (GPIO_ACTIVE_LOW | GPIO_PULL_UP)>;

    col-gpios =
        <&gpio0 106 (GPIO_ACTIVE_LOW | GPIO_PULL_UP)>,
        <&gpio0 104 (GPIO_ACTIVE_LOW | GPIO_PULL_UP)>,
        <&gpio0 11  (GPIO_ACTIVE_LOW | GPIO_PULL_UP)>,
        <&gpio0 100 (GPIO_ACTIVE_LOW | GPIO_PULL_UP)>;
};
